## CMakeLists.txt
```
# SPDX-License-Identifier: Apache-2.0

cmake_minimum_required(VERSION 3.20.0)

find_package(Zephyr REQUIRED HINTS $ENV{ZEPHYR_BASE})
project(hubble-reference-zephyr-ti-simple)

target_sources(app PRIVATE src/main.c)
target_sources(app PRIVATE src/b64.c)
```

## Kconfig
```
# Copyright (c) 2024 HubbleNetwork
# SPDX-License-Identifier: Apache-2.0
#
# This file is the application Kconfig entry point. All application Kconfig
# options can be defined here or included via other application Kconfig files.
# You can browse these options using the west targets menuconfig (terminal) or
# guiconfig (GUI).

menu "Zephyr"
source "Kconfig.zephyr"
endmenu

module = APP
module-str = APP
source "subsys/logging/Kconfig.template.log_config"

config APP_TEMPERATURE
	bool "Include die temperature in BLE advertisement"
	default n
	help
	  When enabled, reads the die temperature using the TI SDK
	  Temperature driver and includes it in the Hubble BLE
	  advertisement payload as a signed int16 (Celsius).
```

## prj.conf
```kconfig
# Logging
CONFIG_LOG=y
CONFIG_LOG_BACKEND_UART=y

# Hubble Network
CONFIG_HUBBLE_BLE_NETWORK=y

# Bluetooth dependencies
CONFIG_BT=y
CONFIG_BT_PERIPHERAL=y

# Main stack size
CONFIG_MAIN_STACK_SIZE=2048

# Use ROM tables to save on RAM
CONFIG_HUBBLE_NETWORK_KEY_256=y
CONFIG_HUBBLE_BLE_NETWORK_MBEDTLS=y
CONFIG_MBEDTLS_AES_ROM_TABLES=y
```

## boards/lp_em_cc2755p10.conf
```kconfig
# Use Zephyr's bundled picolibc module instead of the SDK-provided one.
# Zephyr SDK 0.17.4 ships an older picolibc whose locking API is incompatible
# with Zephyr 3.7.0's libc-hooks.c (struct __lock vs k_mutex mismatch).
CONFIG_PICOLIBC_USE_MODULE=y
CONFIG_APP_TEMPERATURE=y
```

## src/main.c
```c
#include <hubble/hubble.h>
#include <zephyr/kernel.h>
#include <zephyr/bluetooth/bluetooth.h>
#include <zephyr/kernel.h>
#include <zephyr/logging/log.h>
#include <zephyr/drivers/gpio.h>

#include <stdint.h>
#include <stdlib.h>

#include "b64.h"

#ifdef CONFIG_APP_TEMPERATURE
#include <ti/drivers/Temperature.h>
#endif

LOG_MODULE_REGISTER(main, CONFIG_APP_LOG_LEVEL);

/* Macro helpers to turn a macro value into a string literal */
#define STR_HELPER(x) #x
#define STR(x) STR_HELPER(x)

/*
 * We will decode the HUBBLE_KEY_B64_STR config into this
 */
static uint8_t master_key[CONFIG_HUBBLE_KEY_SIZE];

#define ADV_UPDATE_PERIOD_S 300

/* Advertising interval settings */
#define ADV_INTERVAL_S 2
#define ADV_INTERVAL_CNT_MIN (ADV_INTERVAL_S * 1600)
#define ADV_INTERVAL_CNT_MAX (ADV_INTERVAL_S * 2000)

/* Blink settings */
#define BLINK_PERIOD_MS (ADV_INTERVAL_S * 1000)
#define BLINK_ONTIME_MS 100
#define BLINK_OFFTIME_MS (BLINK_PERIOD_MS - BLINK_ONTIME_MS)

/* The devicetree node identifier for the "led0" alias. */
#define LED0_NODE DT_ALIAS(led0)

// Buffer used for Hubble data
// Encrypted data will go in here for the advertisement.
#define HUBBLE_USER_BUFFER_LEN 31
static uint8_t _hubble_user_buffer[HUBBLE_USER_BUFFER_LEN];

/*
 * A build error on this line means your board is unsupported.
 * See the sample documentation for information on how to fix this.
 */
static const struct gpio_dt_spec led = GPIO_DT_SPEC_GET(LED0_NODE, gpios);

static uint16_t app_adv_uuids[1] = {
	HUBBLE_BLE_UUID,
};

static struct bt_data app_ad[2] = {
	BT_DATA(BT_DATA_UUID16_ALL, &app_adv_uuids, sizeof(app_adv_uuids)),
	{},
};

K_SEM_DEFINE(timer_sem, 0, 1);

static void timer_cb(struct k_timer *timer)
{
	k_sem_give(&timer_sem);
}

K_TIMER_DEFINE(message_timer, timer_cb, NULL);

static void blink_timer_cb(struct k_timer *timer)
{
	static bool led_state = false;
	k_timeout_t next = led_state ? K_MSEC(BLINK_OFFTIME_MS) : K_MSEC(BLINK_ONTIME_MS);
	led_state = !led_state;
	gpio_pin_set_dt(&led, led_state);
	k_timer_start(timer, next, K_NO_WAIT);
}
K_TIMER_DEFINE(blink_timer, blink_timer_cb, NULL);

static int decode_master_key(void)
{
	size_t keylen = b64_decoded_size(STR(HUBBLE_KEY));
	if (keylen != sizeof(master_key)) {
		LOG_ERR("Given key incorrect size (%d bytes)", keylen);
		return -1;
	}
	int ret = b64_decode(STR(HUBBLE_KEY), master_key, sizeof(master_key));
	if (ret != 0) {
		LOG_ERR("Failed to decode given key");
		return ret;
	}
	return ret;
}

int main(void)
{
	int err;

	if (!gpio_is_ready_dt(&led)) {
		return 0;
	}

	err = gpio_pin_configure_dt(&led, GPIO_OUTPUT_ACTIVE);
	if (err < 0) {
		return err;
	}

	LOG_DBG("Hubble Network BLE Beacon started");

	/* Synchrounosly initialize the Bluetooth subsystem. */
	err = bt_enable(NULL);
	if (err != 0) {
		LOG_ERR("Bluetooth init failed (err %d)", err);
		return err;
	}

	err = decode_master_key();
	if (err != 0) {
		// Logging done in decode function
		return err;
	}

	err = hubble_init(TIME, master_key);
	if (err != 0) {
		LOG_ERR("Failed to initialize Hubble BLE Network");
		goto end;
	}

	/* Blink an LED as a "proof of life" */
	k_timer_start(&blink_timer, K_NO_WAIT, K_NO_WAIT);

	/* Update the message we send every ADV_UPDATE_PERIOD_S */
	k_timer_start(
		&message_timer,
		K_SECONDS(ADV_UPDATE_PERIOD_S),
		K_SECONDS(ADV_UPDATE_PERIOD_S));

	while (1) {
		size_t out_len = HUBBLE_USER_BUFFER_LEN;
#ifdef CONFIG_APP_TEMPERATURE
		int16_t temp_c = Temperature_getTemperature();

		/* Clamp to int8_t range (-128 to 127) */
		if (temp_c > 127) {
			temp_c = 127;
		} else if (temp_c < -128) {
			temp_c = -128;
		}

		uint8_t payload[2] = {
			0x02,              /* Type ID: Low-Res Temp */
			(uint8_t)temp_c    /* Temperature as int8_t (1°C units) */
		};

		LOG_DBG("Die temperature: %d C", temp_c);
		err = hubble_ble_advertise_get(payload, sizeof(payload),
					       _hubble_user_buffer, &out_len);
#else
		err = hubble_ble_advertise_get(NULL, 0, _hubble_user_buffer, &out_len);
#endif
		if (err != 0) {
			LOG_ERR("Failed to get the advertisement data");
			goto end;
		}
		app_ad[1].data_len = out_len;
		app_ad[1].type = BT_DATA_SVC_DATA16;
		app_ad[1].data = _hubble_user_buffer;

		LOG_DBG("Number of bytes in advertisement: %d", out_len);

		err = bt_le_adv_start(BT_LE_ADV_PARAM(BT_LE_ADV_OPT_USE_NRPA,
					      ADV_INTERVAL_CNT_MIN,
					      ADV_INTERVAL_CNT_MAX, NULL),
				      app_ad, ARRAY_SIZE(app_ad), NULL, 0);
		if (err != 0) {
			LOG_ERR("Bluetooth advertisement failed (err %d)", err);
			goto end;
		}

		k_sem_take(&timer_sem, K_FOREVER);

		err = bt_le_adv_stop();
		if (err != 0) {
			LOG_ERR("Bluetooth advertisement stop failed (err %d)",
				err);
			goto end;
		}
	}

end:
	(void)bt_disable();
	return err;
}
```
